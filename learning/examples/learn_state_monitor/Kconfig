## learning/examples/learn_state_monitor/Kconfig
```kconfig
menuconfig EXAMPLES_LEARN_STATE_MONITOR
	bool "learn_state_monitor"
	default n
	---help---
		Read-only learning monitor for flight state and local position.
```
